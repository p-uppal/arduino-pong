#include <stdlib.h>
#include <Adafruit_ST7735.h>
#include <Adafruit_ST7789.h>
#include <Adafruit_ST77xx.h>

#include <Adafruit_GFX.h>
#include <Adafruit_SPITFT.h>
#include <Adafruit_SPITFT_Macros.h>
#include <gfxfont.h>
/* #include <Adafruit_ZeroDMA.h> */
#include <SPI.h>
#include <Wire.h>



#define UP_BUTTON 2
#define DOWN_BUTTON 3

// Color definitions
/*
  #define BLACK           0x0000
  #define BLUE            0x001F
  #define RED             0xF800
  #define GREEN           0x07E0
  #define CYAN            0x07FF
  #define MAGENTA         0xF81F
  #define YELLOW          0xFFE0
  #define WHITE           0xFFFF
*/


const unsigned long PADDLE_RATE = 20;
const unsigned long BALL_RATE = 15;
const uint8_t PADDLE_HEIGHT = 32;
int MAX_SCORE = 8;

int CPU_SCORE = 0;
int PLAYER_SCORE = 0;


// You can use any (4 or) 5 pins
#define sclk 13
#define mosi 11
#define cs   10
#define rst  9
#define dc   8

// MOSI is Data pin on display breakout
//Adafruit_ST7735 display = Adafruit_ST7735(cs, dc, mosi, sclk, rst);
Adafruit_ST7735 display = Adafruit_ST7735(cs, dc, rst);

void drawCourt();

uint8_t ball_x = 64, ball_y = 32;
uint8_t ball_dir_x = 1, ball_dir_y = 1;

boolean gameIsRunning = true;
boolean resetBall = false;

static const unsigned char title []PROGMEM = {  
    0x00, 0x00, 0x00, 0x0f, 0xf0, 0x40, 0x38, 0x00, 0x00, 0x00, 0x00, 0x00, 0x00, 0x00, 0x1c, 0x00, 0x00, 0x00, 0x00, 0x00, 
    0x00, 0x00, 0x00, 0x7f, 0xfc, 0xc1, 0xf8, 0x00, 0x00, 0x00, 0x00, 0x00, 0x00, 0x00, 0x3c, 0x00, 0x00, 0x00, 0x00, 0x00, 
    0x00, 0x00, 0x00, 0xf8, 0x1f, 0xc2, 0xf8, 0x00, 0x00, 0x00, 0x00, 0x00, 0x00, 0x00, 0x3e, 0x00, 0x00, 0x00, 0x00, 0x00, 
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    0x00, 0x00, 0x00, 0x00, 0x00, 0x00, 0x00, 0x00, 0x00, 0x00, 0x00, 0x00, 0x00, 0x00, 0x00, 0x00, 0x00, 0x00, 0x00, 0x00
};


unsigned long ball_update;
unsigned long paddle_update;

const uint8_t CPU_X = 12;
uint8_t cpu_y = 32;

const uint8_t PLAYER_X = 148;
uint8_t player_y = 32;

void setup() {
  Serial.begin(9600);
  display.initR(INITR_BLACKTAB);      // Init ST7735S chip, black tab
  display.setRotation(3);
  pinMode(UP_BUTTON, INPUT_PULLUP);
  pinMode(DOWN_BUTTON, INPUT_PULLUP);
  //display.begin();
  display.fillScreen(ST77XX_BLACK);
  //display.drawBitmap(3, 0, pong, 89, 24, ST77XX_GREEN);
  //display.drawBitmap(10, 30, game, 75, 26, ST77XX_RED);
  display.drawBitmap(0, 0, title, 158, 126, ST77XX_GREEN);
  while (digitalRead(UP_BUTTON) == HIGH && digitalRead(DOWN_BUTTON) == HIGH)
  {
    delay(100);
  }
  unsigned long start = millis();


  display.fillScreen(ST77XX_BLACK);
  drawCourt();

  while (millis() - start < 2000);
  ball_update = millis();
  paddle_update = ball_update;
  ball_x = random(25, 65);
  ball_y = random(3, 63);
}

void loop() {

  unsigned long time = millis();
  static bool up_state = false;
  static bool down_state = false;

  up_state |= (digitalRead(UP_BUTTON) == LOW);
  down_state |= (digitalRead(DOWN_BUTTON) == LOW);

  if (resetBall)
  {
    ball_x = random(40, 120);
    ball_y = random(3, 126);
    do
    {
      ball_dir_x = random(-1, 2);
    } while (ball_dir_x == 0);

    do
    {
      ball_dir_y = random(-1, 2);
    } while (ball_dir_y == 0);


    resetBall = false;
  }

  if (time > ball_update && gameIsRunning) {
    uint8_t new_x = ball_x + ball_dir_x;
    uint8_t new_y = ball_y + ball_dir_y;

    // Check if we hit the vertical walls
    if (new_x == 0) //Player Gets a Point
    {
      PLAYER_SCORE++;
      if (PLAYER_SCORE == MAX_SCORE)
      {
        gameOver();
      } else
      {
        showScore();
      }
    }

    // Check if we hit the vertical walls
    if (new_x == 158) //CPU Gets a Point
    {
      CPU_SCORE++;
      if (CPU_SCORE == MAX_SCORE)
      {
        gameOver();
      } else
      {
        showScore();
      }
    }

    // Check if we hit the horizontal walls.
    if (new_y == 0 || new_y == 126) {
      ball_dir_y = -ball_dir_y;
      new_y += ball_dir_y + ball_dir_y;
    }

    // Check if we hit the CPU paddle
    if (new_x == CPU_X && new_y >= cpu_y && new_y <= cpu_y + PADDLE_HEIGHT) {
      ball_dir_x = -ball_dir_x;
      new_x += ball_dir_x + ball_dir_x;
    }

    // Check if we hit the player paddle
    if (new_x == PLAYER_X
        && new_y >= player_y
        && new_y <= player_y + PADDLE_HEIGHT)
    {
      ball_dir_x = -ball_dir_x;
      new_x += ball_dir_x + ball_dir_x;
    }

    display.drawPixel(ball_x, ball_y, ST77XX_BLACK);
    display.drawPixel(new_x, new_y, ST77XX_WHITE);
    ball_x = new_x;
    ball_y = new_y;

    ball_update += BALL_RATE;

  }

  if (time > paddle_update && gameIsRunning) {
    paddle_update += PADDLE_RATE;

    // CPU paddle
    display.drawFastVLine(CPU_X, cpu_y, PADDLE_HEIGHT, ST77XX_BLACK);
    const uint8_t half_paddle = PADDLE_HEIGHT >> 1;
    if (cpu_y + half_paddle > ball_y) {
      cpu_y -= 1;
    }
    if (cpu_y + half_paddle < ball_y) {
      cpu_y += 1;
    }
    if (cpu_y < 1) cpu_y = 1;
    if (cpu_y + PADDLE_HEIGHT > 127) cpu_y = 127 - PADDLE_HEIGHT;
    display.drawFastVLine(CPU_X, cpu_y, PADDLE_HEIGHT, ST77XX_MAGENTA);

    // Player paddle
    display.drawFastVLine(PLAYER_X, player_y, PADDLE_HEIGHT, ST77XX_BLACK);
    if (up_state) {
      player_y -= 1;
    }
    if (down_state) {
      player_y += 1;
    }
    up_state = down_state = false;
    if (player_y < 1) player_y = 1;
    if (player_y + PADDLE_HEIGHT > 127) player_y = 127 - PADDLE_HEIGHT;
    display.drawFastVLine(PLAYER_X, player_y, PADDLE_HEIGHT, ST77XX_CYAN);
  }
}

void drawCourt() {
  display.drawRect(0, 0, display.width(), display.height(), ST77XX_WHITE);
}

void gameOver()
{
  gameIsRunning = false;
  display.fillScreen(ST77XX_BLACK);
  drawCourt();
  if (PLAYER_SCORE > CPU_SCORE)
  {
    display.setCursor(5, 4);
    display.setTextColor(ST77XX_WHITE);
    display.setTextSize(2);
    display.print("You Won");
  } else
  {
    display.setCursor(5, 4);
    display.setTextColor(ST77XX_WHITE);
    display.setTextSize(2);
    display.print("CPU WON");
  }

  display.setCursor(20, 30);
  display.setTextColor(ST77XX_RED);
  display.setTextSize(3);
  display.print(String(CPU_SCORE));

  display.setCursor(60, 30);
  display.setTextColor(ST77XX_GREEN);
  display.setTextSize(3);
  display.print(String(PLAYER_SCORE));

  delay(2000);

  while (digitalRead(UP_BUTTON) == HIGH && digitalRead(DOWN_BUTTON) == HIGH)
  {
    delay(100);
  }
  gameIsRunning = true;

  CPU_SCORE = PLAYER_SCORE = 0;

  unsigned long start = millis();
  display.fillScreen(ST77XX_BLACK);
  drawCourt();
  while (millis() - start < 2000);
  ball_update = millis();
  paddle_update = ball_update;
  gameIsRunning = true;
  resetBall = true;
}

void showScore()
{
  gameIsRunning = false;
  display.fillScreen(ST77XX_BLACK);
  drawCourt();

  display.setCursor(15, 4);
  display.setTextColor(ST77XX_WHITE);
  display.setTextSize(2);
  display.print("Score");

  display.setCursor(20, 30);
  display.setTextColor(ST77XX_RED);
  display.setTextSize(3);
  display.print(String(CPU_SCORE));

  display.setCursor(60, 30);
  display.setTextColor(ST77XX_GREEN);
  display.setTextSize(3);
  display.print(String(PLAYER_SCORE));

  delay(2000);
  unsigned long start = millis();

  display.fillScreen(ST77XX_BLACK);
  drawCourt();
  while (millis() - start < 2000);
  ball_update = millis();
  paddle_update = ball_update;
  gameIsRunning = true;
  resetBall = true;
}
